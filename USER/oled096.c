#include "oled096.h"

uint8_t ascii8x16[95][16]={
    //ascii code = index + 32
    {0x00,0x00,0x00,0x00,0x00,0x00,0x00,0x00,
     0x00,0x00,0x00,0x00,0x00,0x00,0x00,0x00},// 0
    
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    {0x00,0x02,0x01,0x02,0x02,0x04,0x02,0x00,
     0x00,0x00,0x00,0x00,0x00,0x00,0x00,0x00}//~94
};

//private functions

void OLED096_pinCtrl(OLED096_Pin pin, uint8_t status){ //BSP Function
    BitAction action = Bit_SET;
    if(status == 0){
        action = Bit_RESET;
    }
    if(pin == OLED096_Pin_DC){
        GPIO_WriteBit(GPIOB, GPIO_Pin_9, action);
    }
    else if(pin == OLED096_Pin_RST){
        GPIO_WriteBit(GPIOB, GPIO_Pin_8, action);
    }
    else if(pin == OLED096_Pin_NSS){
        GPIO_WriteBit(GPIOA, GPIO_Pin_4, action);
    }
}

void OLED096_hwInit(){ //BSP Function
    RCC_APB2PeriphClockCmd(RCC_APB2Periph_SPI1, ENABLE);
    RCC_APB2PeriphClockCmd(RCC_APB2Periph_GPIOA, ENABLE);
    RCC_APB2PeriphClockCmd(RCC_APB2Periph_GPIOB, ENABLE);
    
    GPIO_InitTypeDef GPIO_InitStructure;
    GPIO_InitStructure.GPIO_Pin = GPIO_Pin_5 | GPIO_Pin_7;
    GPIO_InitStructure.GPIO_Mode = GPIO_Mode_AF_PP;
    GPIO_InitStructure.GPIO_Speed = GPIO_Speed_50MHz;
    GPIO_Init(GPIOA, &GPIO_InitStructure);
    GPIO_InitStructure.GPIO_Pin = GPIO_Pin_6;
    GPIO_InitStructure.GPIO_Mode = GPIO_Mode_IN_FLOATING;
    GPIO_InitStructure.GPIO_Speed = GPIO_Speed_50MHz;
    GPIO_Init(GPIOA, &GPIO_InitStructure);
    GPIO_InitStructure.GPIO_Pin = GPIO_Pin_4;
    GPIO_InitStructure.GPIO_Mode = GPIO_Mode_Out_PP;
    GPIO_InitStructure.GPIO_Speed = GPIO_Speed_50MHz;
    GPIO_Init(GPIOA, &GPIO_InitStructure);
    GPIO_InitStructure.GPIO_Pin = GPIO_Pin_8 | GPIO_Pin_9;
    GPIO_InitStructure.GPIO_Mode = GPIO_Mode_Out_PP;
    GPIO_InitStructure.GPIO_Speed = GPIO_Speed_50MHz;
    GPIO_Init(GPIOB, &GPIO_InitStructure);
    
    SPI_InitTypeDef SPI_InitStructure;
    SPI_InitStructure.SPI_BaudRatePrescaler = SPI_BaudRatePrescaler_16;
    SPI_InitStructure.SPI_CPHA = SPI_CPHA_1Edge;
    SPI_InitStructure.SPI_CPOL = SPI_CPOL_Low;
    SPI_InitStructure.SPI_CRCPolynomial = 7;
    SPI_InitStructure.SPI_DataSize = SPI_DataSize_8b;
    SPI_InitStructure.SPI_Direction = SPI_Direction_2Lines_FullDuplex;
    SPI_InitStructure.SPI_FirstBit = SPI_FirstBit_MSB;
    SPI_InitStructure.SPI_Mode = SPI_Mode_Master;
    SPI_InitStructure.SPI_NSS = SPI_NSS_Soft;
    SPI_Init(SPI1, &SPI_InitStructure);
    SPI_Cmd(SPI1, ENABLE);
}

uint8_t OLED096_SPIWriteReadByte(uint8_t txData){ //BSP Function
    uint8_t retry = 0;
    while(SPI_I2S_GetFlagStatus(SPI1, SPI_I2S_FLAG_TXE) == RESET){
        retry++;
        if(retry > 200){
            return 0;
        }
    }
    SPI_I2S_SendData(SPI1, txData);
    retry = 0;
    while(SPI_I2S_GetFlagStatus(SPI1, SPI_I2S_FLAG_RXNE) == RESET){
        retry++;
        if(retry > 200){
            return 0;
        }
    }
    return SPI_I2S_ReceiveData(SPI1);
}

void OLED096_writeByte(uint8_t data, OLED096_WriteAction action){
    if(action == OLED096_WriteAction_Cmd){
        OLED096_pinCtrl(OLED096_Pin_DC, 0);
    }
    else if(action == OLED096_WriteAction_Data){
        OLED096_pinCtrl(OLED096_Pin_DC, 1);
    }
    OLED096_pinCtrl(OLED096_Pin_NSS, 0);
    OLED096_SPIWriteReadByte(data);
    OLED096_pinCtrl(OLED096_Pin_NSS, 1);
}

//public functions

void OLED096_init(){
    delay_init();
    OLED096_hwInit();
    OLED096_reset();
}

void OLED096_reset(){
    OLED096_pinCtrl(OLED096_Pin_DC, 1);
    OLED096_pinCtrl(OLED096_Pin_NSS, 1);
    OLED096_pinCtrl(OLED096_Pin_RST, 1);
    delay_us(20);
    
    OLED096_pinCtrl(OLED096_Pin_RST, 0);
    delay_us(20);
    OLED096_pinCtrl(OLED096_Pin_RST, 1);
    delay_us(20);
    
    /* Screen Configuration */
    //Set Display ON/OFF:off
    OLED096_writeByte(0xAE,OLED096_WriteAction_Cmd);
    //Set Memory Addressing Mode:Page Addressing Mode
    OLED096_writeByte(0x20,OLED096_WriteAction_Cmd);
	OLED096_writeByte(0x10,OLED096_WriteAction_Cmd);
    //Set Page Start Address for Page Addressing Mode:0(for setting current address)  
    OLED096_writeByte(0xB0,OLED096_WriteAction_Cmd);
    //Set Lower Column Start Address for Page Addressing Mode:0(for setting current address)
    OLED096_writeByte(0x00,OLED096_WriteAction_Cmd); 
    //Set Higher Column Start Address for Page Addressing Mode:0(for setting current address)
    OLED096_writeByte(0x10,OLED096_WriteAction_Cmd);
    //Set COM Output Scan Direction:remapped mode(for re-mapping)
	OLED096_writeByte(0xC8,OLED096_WriteAction_Cmd);
    //Set Segment Re-map:Column address 0 is mapped to SEG0(for re-mapping)
    OLED096_writeByte(0xA1,OLED096_WriteAction_Cmd);
    //Set Display Start Line:40h
    OLED096_writeByte(0x40,OLED096_WriteAction_Cmd);
    //Set Display Offset:0
    OLED096_writeByte(0xD3,OLED096_WriteAction_Cmd);
	OLED096_writeByte(0x00,OLED096_WriteAction_Cmd);
    //Set Normal/Inverse Display:Normal Display
	OLED096_writeByte(0xA6,OLED096_WriteAction_Cmd);
    //Set multiplex ratio:64
    OLED096_writeByte(0xA8,OLED096_WriteAction_Cmd);
    OLED096_writeByte(0x3F,OLED096_WriteAction_Cmd);
    //Entire Display ON:Resume to RAM content display 
	OLED096_writeByte(0xA4,OLED096_WriteAction_Cmd);
    //Set Display Clock Divide Ratio/Oscillator Frequency:Highest Frequency and no division
	OLED096_writeByte(0xD5,OLED096_WriteAction_Cmd);
	OLED096_writeByte(0xF0,OLED096_WriteAction_Cmd);
    //Set Contrast Control:ffh
    OLED096_writeByte(0x81,OLED096_WriteAction_Cmd);
	OLED096_writeByte(0xFF,OLED096_WriteAction_Cmd);
    //Set Pre-charge Period
	OLED096_writeByte(0xD9,OLED096_WriteAction_Cmd); 
	OLED096_writeByte(0x22,OLED096_WriteAction_Cmd);
    //Set COM Pins Hardware Configuration:Default
	OLED096_writeByte(0xDA,OLED096_WriteAction_Cmd);
	OLED096_writeByte(0x12,OLED096_WriteAction_Cmd);
    //Set Vcomh Deselect Level:0.77Vcc,default
	OLED096_writeByte(0xDB,OLED096_WriteAction_Cmd);
	OLED096_writeByte(0x20,OLED096_WriteAction_Cmd);
    //Charge Bump:Enable
	OLED096_writeByte(0x8D,OLED096_WriteAction_Cmd);
	OLED096_writeByte(0x14,OLED096_WriteAction_Cmd);
    //Set Display ON/OFF:on
	OLED096_writeByte(0xAF,OLED096_WriteAction_Cmd);
    
    OLED096_clearScreen();
}

void OLED096_clearScreen(){
    uint8_t i, n;
    for(i = 0; i < 8; i++){
        OLED096_writeByte(0xB0 + i, OLED096_WriteAction_Cmd);
        OLED096_writeByte(0x00, OLED096_WriteAction_Cmd);
        OLED096_writeByte(0x10, OLED096_WriteAction_Cmd);
        for(n = 0; n < 128; n++){
            OLED096_writeByte(0x00, OLED096_WriteAction_Data); 
        }
    }
}

void OLED096_writeLine(uint8_t row, OLED096_Align align, uint8_t reverseColor, char* str){
    //Usage: row 0-3
    if(row > 3){
        return;
    }
    //clear row
    int16_t colIndex, i;
    for(i = 0; i < 2; i++){
        OLED096_writeByte(0xB0 + row * 2 + i, OLED096_WriteAction_Cmd);
        OLED096_writeByte(0x00, OLED096_WriteAction_Cmd);
        OLED096_writeByte(0x10, OLED096_WriteAction_Cmd);
        if(reverseColor == 0){
            for(colIndex = 0; colIndex < 128; colIndex++){
                OLED096_writeByte(0x00, OLED096_WriteAction_Data); 
            }
        }
        else{
            for(colIndex = 0; colIndex < 128; colIndex++){
                OLED096_writeByte(0xFF, OLED096_WriteAction_Data); 
            }
        }
    }
    //write row
    char* str1 = str;
    int16_t colStartIndex;
    uint8_t strLength = 0;
    while((*str1) != '\0'){
        str1++;
        strLength++;
    }
    if(align == OLED096_Align_Left){
        colStartIndex = 0;
    }
    else if(align == OLED096_Align_Center){
        colStartIndex = 64 - strLength * 4;
    }
    else if(align == OLED096_Align_Right){
        colStartIndex = 128 - strLength * 8;
    }
    for(i = 0; i < 2; i++){
        str1 = str;
        colIndex = colStartIndex;
        uint8_t start = 0;
        OLED096_writeByte(0xB0 + row * 2 + i, OLED096_WriteAction_Cmd);
        while((*str1) != '\0'){
            uint8_t j;
            for(j = 0; j < 8; j++){
                if(colIndex >= 0 && colIndex <=127){
                    if(start == 0){
                        OLED096_writeByte(0x00 + (((uint8_t)colIndex) & 0x0F), OLED096_WriteAction_Cmd);
                        OLED096_writeByte(0x10 + ((((uint8_t)colIndex) & 0xF0) >> 4), OLED096_WriteAction_Cmd); 
                        start = 1;
                    }
                    if(reverseColor == 0){
                        OLED096_writeByte(ascii8x16[(*str1) - 32][j + 8 * i], OLED096_WriteAction_Data);
                    }
                    else{
                        OLED096_writeByte(~(ascii8x16[(*str1) - 32][j + 8 * i]), OLED096_WriteAction_Data);
                    }
                }
                colIndex++;
            }
            str1++;
        }
    }
}

void OLED096_writeScreen(char* str){
    OLED096_clearScreen();
    char* str1;
    uint8_t i, j, k, m;
    uint8_t end;
    for(m = 0; m < 2; m++){
        str1 = str;
        end = 0;
        for(i = 0; i < 4; i++){
            OLED096_writeByte(0xB0 + i * 2 + m, OLED096_WriteAction_Cmd);
            OLED096_writeByte(0x00, OLED096_WriteAction_Cmd);
            OLED096_writeByte(0x10, OLED096_WriteAction_Cmd); 
            for(j = 0; j < 16; j++){
                if((*str1) != '\0'){
                    for(k = 0; k < 8; k++){
                        OLED096_writeByte(ascii8x16[(*str1) - 32][k + 8 * m], OLED096_WriteAction_Data); 
                    }
                    str1++;
                }
                else{
                    end = 1;
                    break;
                } 
            }
            if(end == 1){
                break;
            }
        }
    }
}

void OLED096_playTestAnimateOnce(){
    uint8_t i,n;		    
    for(i=0;i<8;i++)  
    {  
        OLED096_writeByte (0xb0+i,OLED096_WriteAction_Cmd);
        OLED096_writeByte (0x00,OLED096_WriteAction_Cmd);
        OLED096_writeByte (0x10,OLED096_WriteAction_Cmd);
        for(n=0;n<128;n++){
            OLED096_writeByte(0x00,OLED096_WriteAction_Data);
        }
    }
    delay_ms(200);
    for(i=0;i<8;i++)  
    {  
        OLED096_writeByte (0xb0+i,OLED096_WriteAction_Cmd);
        OLED096_writeByte (0x00,OLED096_WriteAction_Cmd);
        OLED096_writeByte (0x10,OLED096_WriteAction_Cmd);
        for(n=0;n<128;n++){
            OLED096_writeByte(0x01,OLED096_WriteAction_Data);
        }
    }
    delay_ms(200);
    for(i=0;i<8;i++)  
    {  
        OLED096_writeByte (0xb0+i,OLED096_WriteAction_Cmd);
        OLED096_writeByte (0x00,OLED096_WriteAction_Cmd);
        OLED096_writeByte (0x10,OLED096_WriteAction_Cmd);
        for(n=0;n<128;n++){
            OLED096_writeByte(0x03,OLED096_WriteAction_Data);
        }
    }
    delay_ms(200);
    for(i=0;i<8;i++)  
    {  
        OLED096_writeByte (0xb0+i,OLED096_WriteAction_Cmd);
        OLED096_writeByte (0x00,OLED096_WriteAction_Cmd);
        OLED096_writeByte (0x10,OLED096_WriteAction_Cmd);      
        for(n=0;n<128;n++){
            OLED096_writeByte(0x07,OLED096_WriteAction_Data);
        }
    }
    delay_ms(200);
    for(i=0;i<8;i++)  
    {  
        OLED096_writeByte (0xb0+i,OLED096_WriteAction_Cmd);
        OLED096_writeByte (0x00,OLED096_WriteAction_Cmd);
        OLED096_writeByte (0x10,OLED096_WriteAction_Cmd);      
        for(n=0;n<128;n++){
            OLED096_writeByte(0x0F,OLED096_WriteAction_Data);
        }
    }
    delay_ms(200);
    for(i=0;i<8;i++)  
    {  
        OLED096_writeByte (0xb0+i,OLED096_WriteAction_Cmd);
        OLED096_writeByte (0x00,OLED096_WriteAction_Cmd);
        OLED096_writeByte (0x10,OLED096_WriteAction_Cmd); 
        for(n=0;n<128;n++){
            OLED096_writeByte(0x1F,OLED096_WriteAction_Data);
        }
    }
    delay_ms(200);
    for(i=0;i<8;i++)  
    {  
        OLED096_writeByte (0xb0+i,OLED096_WriteAction_Cmd);
        OLED096_writeByte (0x00,OLED096_WriteAction_Cmd);
        OLED096_writeByte (0x10,OLED096_WriteAction_Cmd);
        for(n=0;n<128;n++){
            OLED096_writeByte(0x3F,OLED096_WriteAction_Data);
        }
    }
    delay_ms(200);
    for(i=0;i<8;i++)  
    {  
        OLED096_writeByte (0xb0+i,OLED096_WriteAction_Cmd);
        OLED096_writeByte (0x00,OLED096_WriteAction_Cmd);
        OLED096_writeByte (0x10,OLED096_WriteAction_Cmd); 
        for(n=0;n<128;n++){
            OLED096_writeByte(0x7F,OLED096_WriteAction_Data);
        }
    }
    delay_ms(200);
    for(i=0;i<8;i++)  
    {  
        OLED096_writeByte (0xb0+i,OLED096_WriteAction_Cmd);
        OLED096_writeByte (0x00,OLED096_WriteAction_Cmd);
        OLED096_writeByte (0x10,OLED096_WriteAction_Cmd);
        for(n=0;n<128;n++){
            OLED096_writeByte(0xFF,OLED096_WriteAction_Data);
        }
    }
    delay_ms(1000);
}

void OLED096_setContrast(uint8_t contrast){
    //Set Contrast Control:ffh
    OLED096_writeByte(0x81, OLED096_WriteAction_Cmd);
	OLED096_writeByte(contrast, OLED096_WriteAction_Cmd);
}
